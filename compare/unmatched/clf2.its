## compare/unmatched/clf2.its
```
/dts-v1/;

/ {
    description = "bare-metal counter firmware";
    #address-cells = <2>;

    images {
        firmware {
            description = "M-mode firmware";
            data = /incbin/("clf2.bin");
            type = "firmware";
            arch = "riscv";
            os = "u-boot";
            load = <0x0 0x80000000>;
            entry = <0x0 0x80000000>;
            compression = "none";
        };
    };

    configurations {
        default = "conf";
        conf {
            description = "bare-metal";
            firmware = "firmware";
        };
    };
};
```
